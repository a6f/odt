/ {
    hex = <0xFEDCBA0fedbcda 71737335773773018>;
    oct = <0o76543210 16434824>;
    bin = <0b10101010 170>;

    hex_sep = <0x_0000_0080__0000_0000 (1<<39)>;
    oct_sep = <0o_777_777 262143>;
    bin_sep = <0b_11_11__ 15>;
    dec_sep = <1_000_000 (1000*1000)>;

    float1 = <(1/2) 0.5>;
    float2 = <2 2.0_>;
    float3 = <(1/(1<<30)) 0.000000000931322574615478515625>;
    float4 = <(1/(1<<62)) 00000000000000000000000000000000.00000000000000000021684043449710088680149056017398834228515625>;
    float5 = <125 (~~(2.236068 * 2.236068 * 02.236068 * 0_2_.236068 * 02__.236068 * 0__2.236068))>;
    float6 = <262_53741_26407_68736 262_53741_26407_68743_.99999_99999_99250_073>;

    float_saturates = <(~0) 999999999999999999999999999999.9>;
};
